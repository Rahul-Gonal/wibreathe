## firmware/csi_rx/main/Kconfig.projbuild
```kconfig
menu "WiBreathe CSI Receiver Configuration"

    config WIBREATHE_RX_CHANNEL
        int "Wi-Fi Reception Channel"
        default 6
        range 1 11
        help
            Channel to listen on. Must match transmitter channel (standard 2.4 GHz channels 1-11).

    config WIBREATHE_FILTER_MAC
        string "Filter by Transmitter MAC Address"
        default ""
        help
            Format: AA:BB:CC:DD:EE:FF. Leave blank to accept packets from all transmitters.

    config WIBREATHE_ONLY_HT_FRAMES
        bool "Drop non-HT frames (sig_mode != 1)"
        default y
        help
            Filter out legacy non-HT OFDM and 802.11b frames. Only HT20 frames (sig_mode == 1)
            produce valid CSI on ESP32 hardware.

    config WIBREATHE_SERIAL_BAUD
        int "UART CSI Stream Baud Rate"
        default 921600
        help
            Serial baud rate for CSI_DATA logging to laptop. Must match host settings.

    choice WIBREATHE_CSI_SET
        prompt "CSI Subcarrier Acquisition Set"
        default WIBREATHE_CSI_LLTF_ONLY
        help
            Select whether to acquire LLTF only (128 values, 64 subcarriers)
            or LLTF + HT-LTF (384 values in HT20 mode). LLTF-only is recommended
            for 50 Hz streaming to conserve serial bandwidth headroom.

        config WIBREATHE_CSI_LLTF_ONLY
            bool "LLTF Only (128 values / 64 subcarriers, ~540 B/line)"

        config WIBREATHE_CSI_LLTF_HTLTF
            bool "LLTF + HT-LTF (384 values / 192 subcarriers, ~1450 B/line)"
    endchoice

    config WIBREATHE_EXPECTED_RATE_HZ
        int "Expected CSI Packet Rate (Hz)"
        default 50
        range 1 100
        help
            Nominal transmitter packet rate used for serial bandwidth budget calculations.

    config WIBREATHE_OLED_ENABLE
        bool "Enable I2C OLED Display"
        default y
        help
            Enables 128x64 I2C OLED display for status and live BPM readout.

    choice WIBREATHE_OLED_CONTROLLER
        prompt "OLED Display Controller IC"
        default WIBREATHE_OLED_SSD1306
        depends on WIBREATHE_OLED_ENABLE
        help
            Select controller IC. SSD1306 is standard; SH1106 has a 2-column RAM offset.

        config WIBREATHE_OLED_SSD1306
            bool "SSD1306 (Standard 128x64, 0-offset)"

        config WIBREATHE_OLED_SH1106
            bool "SH1106 (132x64 with 2-column offset)"
    endchoice

    config WIBREATHE_OLED_SDA_PIN
        int "OLED I2C SDA GPIO Pin"
        default 21
        help
            GPIO pin for I2C Data line. Default 21 on classic ESP32 DevKit V1 (ESP32-S3 uses GPIO 8).

    config WIBREATHE_OLED_SCL_PIN
        int "OLED I2C SCL GPIO Pin"
        default 22
        help
            GPIO pin for I2C Clock line. Default 22 on classic ESP32 DevKit V1 (ESP32-S3 uses GPIO 9).

    config WIBREATHE_OLED_I2C_ADDR
        hex "OLED I2C Address"
        default 0x3C
        help
            I2C 7-bit slave address of OLED module (typically 0x3C or 0x3D).

    config WIBREATHE_OLED_I2C_FREQ_HZ
        int "OLED I2C Bus Frequency (Hz)"
        default 100000
        depends on WIBREATHE_OLED_ENABLE
        help
            I2C master clock speed in Hz (default 100000 for 100 kHz standard mode).

    config WIBREATHE_NO_LINK_TIMEOUT_SEC
        int "Display 'No Link' Timeout (seconds)"
        default 5
        range 2 30
        help
            Time without receiving downstream DISP command before showing 'No Link' screen.

    config WIBREATHE_ONDEVICE_MOTION
        bool "Enable On-Device Variance Motion Detection (Stretch Goal)"
        default n
        help
            Enables lightweight rolling-variance motion detection directly on ESP32.

endmenu
```

## firmware/csi_tx/main/Kconfig.projbuild
```kconfig
menu "WiBreathe CSI Transmitter Configuration"

    config WIBREATHE_TX_CHANNEL
        int "Wi-Fi Primary Channel"
        default 6
        range 1 13
        help
            Primary 2.4 GHz channel for broadcast packets. Must match the receiver.

    config WIBREATHE_TX_RATE_HZ
        int "Packet Transmission Cadence (Hz)"
        default 50
        range 10 100
        help
            Frequency of ESP-NOW broadcast packet transmissions.

    config WIBREATHE_TX_POWER_DBM
        int "Wi-Fi TX Power (dBm)"
        default 20
        range 8 20
        help
            Transmission power level for the transmitter Wi-Fi radio.

endmenu
```
